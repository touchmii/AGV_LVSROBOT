## Kconfig
```kconfig
mainmenu "RT-Thread Configuration"

config BSP_DIR
    string
    option env="BSP_ROOT"
    default "."

config RTT_DIR
    string
    option env="RTT_ROOT"
    default "rt-thread"

config PKGS_DIR
    string
    option env="PKGS_ROOT"
    default "rt-thread/packages"

source "$RTT_DIR/Kconfig"
source "$RTT_DIR/packages/packages/Kconfig"
#source "$PKGS_DIR/packages/misc/samples/Kconfig"

config RT_STUDIO_BUILT_IN
    bool
    select ARCH_ARM_CORTEX_M4
    select RT_USING_COMPONENTS_INIT
    select RT_USING_USER_MAIN
    default y
```
